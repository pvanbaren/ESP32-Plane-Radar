#include "hardware/qualia_nv3052c.h"

#if defined(TARGET_QUALIA_S3)

#include <Arduino.h>
#include <Wire.h>

namespace {

// --- TCA9554 I2C expander (Qualia default address) ---
constexpr uint8_t kExpanderAddr = 0x3F;
constexpr int kI2cSda = 8;
constexpr int kI2cScl = 18;

// TCA9554 registers
constexpr uint8_t kRegOutput = 0x01;   // output port
constexpr uint8_t kRegPolarity = 0x02;  // polarity inversion
constexpr uint8_t kRegConfig = 0x03;   // direction (1 = input, 0 = output)

// Expander bit assignments (from the board definition)
constexpr uint8_t kBitClk = 1 << 0;
constexpr uint8_t kBitCs = 1 << 1;
constexpr uint8_t kBitReset = 1 << 2;
constexpr uint8_t kBitMosi = 1 << 7;

// Direction: clk/cs/reset/mosi are outputs (0), the rest inputs. 0x78 matches
// Adafruit's proven CircuitPython bus-init for this board.
constexpr uint8_t kConfigValue = 0x78;
// Initial output-port shadow (matches CircuitPython gpio_data default).
constexpr uint8_t kInitialOutput = 0xFD;

constexpr uint8_t kDelayFlag = 0x80;

// NV3052C init sequence for the Adafruit 4" round 720x720 panel, transcribed
// verbatim from adafruit_qualia/displays/round40.py. Framing per init step:
//   cmd, len|DELAY, data[len], (delay_ms if DELAY set; 0xFF means 500 ms)
// The command byte is sent with DC=0, data bytes with DC=1 (9-bit SPI).
const uint8_t kNv3052cInit[] = {
    0xFF, 0x01, 0x30, 0xFF, 0x01, 0x52, 0xFF, 0x01, 0x01, 0xE3, 0x01, 0x00,
    0x0A, 0x01, 0x11, 0x23, 0x01, 0xA0, 0x24, 0x01, 0x32, 0x25, 0x01, 0x12,
    0x26, 0x01, 0x2E, 0x27, 0x01, 0x2E, 0x29, 0x01, 0x02, 0x2A, 0x01, 0xCF,
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    0x00, 0x64,
};

uint8_t g_output_shadow = kInitialOutput;

void expanderWriteReg(uint8_t reg, uint8_t value) {
  Wire.beginTransmission(kExpanderAddr);
  Wire.write(reg);
  Wire.write(value);
  Wire.endTransmission();
}

// Update the output port: set `set_bits`, clear `clear_bits`, keep the rest.
void pinChange(uint8_t set_bits, uint8_t clear_bits) {
  g_output_shadow = (g_output_shadow & ~clear_bits) | set_bits;
  expanderWriteReg(kRegOutput, g_output_shadow);
}

// Bit-bang `len` bytes as 9-bit words (DC bit first, MSB->LSB), CPOL=CPHA=0.
// DC=0 for command bytes, DC=1 for data bytes.
void spiSend(bool is_command, const uint8_t* data, size_t len) {
  const int dc_mask = is_command ? 0x000 : 0x100;
  for (size_t i = 0; i < len; ++i) {
    int bits = data[i] | dc_mask;
    for (int j = 0; j < 9; ++j) {
      if (bits & 0x100) {
        pinChange(kBitMosi, kBitClk | kBitCs);
      } else {
        pinChange(0, kBitMosi | kBitClk | kBitCs);
      }
      pinChange(kBitClk, 0);  // latch on rising edge
      bits <<= 1;
    }
  }
}

}  // namespace

bool qualiaPanelInit() {
  Wire.begin(kI2cSda, kI2cScl);
  Wire.setClock(400000);

  // Probe the expander.
  Wire.beginTransmission(kExpanderAddr);
  if (Wire.endTransmission() != 0) {
    Serial.printf("TCA9554 not found at 0x%02X\n", kExpanderAddr);
    return false;
  }

  // Configure expander: set pin directions, disable polarity inversion.
  expanderWriteReg(kRegConfig, kConfigValue);
  expanderWriteReg(kRegPolarity, 0x00);

  // Idle CLK, deassert CS, assert RESET (active low), then release.
  pinChange(kBitCs, kBitClk | kBitReset);
  delay(10);
  pinChange(kBitReset, 0);
  delay(100);

  // Walk the init sequence.
  const size_t len = sizeof(kNv3052cInit);
  size_t i = 0;
  while (i < len) {
    const uint8_t cmd = kNv3052cInit[i];
    uint8_t data_size = kNv3052cInit[i + 1];
    const bool has_delay = (data_size & kDelayFlag) != 0;
    data_size &= ~kDelayFlag;
    const uint8_t* data = &kNv3052cInit[i + 2];

    spiSend(true, &cmd, 1);
    spiSend(false, data, data_size);

    pinChange(0, kBitClk);  // idle CLK
    pinChange(kBitCs, 0);   // deassert CS

    if (has_delay) {
      uint16_t delay_ms = kNv3052cInit[i + 2 + data_size];
      if (delay_ms == 255) {
        delay_ms = 500;
      }
      delay(delay_ms);
      ++data_size;  // account for the delay byte
    }
    i += 2 + data_size;
  }

  Serial.println("NV3052C panel init sent");
  return true;
}

#endif  // TARGET_QUALIA_S3
